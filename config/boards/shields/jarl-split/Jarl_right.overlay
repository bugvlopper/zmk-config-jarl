#include "iris.dtsi"

&kscan0 {

	col-gpios
		= <&gpio0 22 (GPIO_ACTIVE_HIGH | GPIO_PULL_DOWN)>
		, <&gpio0 24 (GPIO_ACTIVE_HIGH | GPIO_PULL_DOWN)>
		, <&gpio1 00 (GPIO_ACTIVE_HIGH | GPIO_PULL_DOWN)>
		, <&gpio0 11 (GPIO_ACTIVE_HIGH | GPIO_PULL_DOWN)>
		, <&gpio1 04 (GPIO_ACTIVE_HIGH | GPIO_PULL_DOWN)>
		, <&gpio1 06 (GPIO_ACTIVE_HIGH | GPIO_PULL_DOWN)>
		;
};

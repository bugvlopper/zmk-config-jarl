## boards/shields/half/Kconfig.defconfig
```kconfig
if SHIELD_half

config ZMK_KEYBOARD_NAME
	default "half"
endif

if ZMK_DISPLAY

config I2C
default y

config SSD1306
default y

endif # ZMK_DISPLAY
```

## boards/shields/jarl/Kconfig.shield
```kconfig
config SHIELD_JARL_LEFT
	def_bool $(shields_list_contains, jarl_left)
config SHIELD_JARL_RIGHT
	def_bool $(shields_list_contains, jarl_right)
```

## config/boards/shields/jarl-split/Kconfig.defconfig
```kconfig
if SHIELD_JARL_LEFT
	config ZMK_KEYBOARD_NAME
		default "Jarl"

	config ZMK_SPLIT_ROLE_CENTRAL
		default y
endif

if SHIELD_JARL_LEFT || SHIELD_JARL_RIGHT
	config ZMK_SPLIT
		default y
endif
```

## config/boards/shields/jarl-split/Kconfig.shield
```kconfig
config SHIELD_JARL_LEFT
	def_bool $(shields_list_contains, Jarl_left)
config SHIELD_JARL_RIGHT
	def_bool $(shields_list_contains, Jarl_right)
```
